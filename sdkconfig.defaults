## sdkconfig.defaults
```kconfig
CONFIG_IDF_TARGET="esp32s3"

CONFIG_ESPTOOLPY_FLASHSIZE_8MB=y
CONFIG_ESPTOOLPY_FLASHSIZE="8MB"

CONFIG_PARTITION_TABLE_CUSTOM=y
CONFIG_PARTITION_TABLE_CUSTOM_FILENAME="partitions.csv"

CONFIG_COMPILER_OPTIMIZATION_SIZE=y

CONFIG_ESP_MAIN_TASK_STACK_SIZE=16384

# CONFIG_SPIRAM is not set

# CONFIG_ESP_CONSOLE_UART_DEFAULT is not set
CONFIG_ESP_CONSOLE_USB_SERIAL_JTAG=y
CONFIG_ESP_CONSOLE_SECONDARY_NONE=y

# microSD (FAT over SPI). SD uses 512-byte sectors; long file names keep the
# case of Pin_data.
# CONFIG_FATFS_SECTOR_4096 is not set
CONFIG_FATFS_SECTOR_512=y
# CONFIG_FATFS_LFN_NONE is not set
CONFIG_FATFS_LFN_STACK=y
CONFIG_FATFS_MAX_LFN=32
```
